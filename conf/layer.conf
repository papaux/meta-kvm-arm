## conf/layer.conf
```bitbake
# We have a conf and classes directory, add to BBPATH
BBPATH .= ":${LAYERDIR}"

# We have recipes-* directories, add to BBFILES
BBFILES += "${LAYERDIR}/recipes-*/*/*.bb \
	${LAYERDIR}/recipes-*/*/*.bbappend"

BBFILE_COLLECTIONS += "omap5-kvm"
BBFILE_PATTERN_omap5-kvm = "^${LAYERDIR}/"
BBFILE_PRIORITY_omap5-kvm = "6"
```

## conf/machine/include/odroidxu-a15-kvm.inc
```bitbake
SOC_FAMILY = "odroidxu-a15"
require conf/machine/include/soc-family.inc

require conf/machine/include/tune-cortexa15.inc

# Increase this everytime you change something in the kernel
MACHINE_KERNEL_PR = "r0"

PREFERRED_PROVIDER_virtual/kernel = "linux-hardkernel-odroid"
PREFERRED_PROVIDER_virtual/bootloader = "u-boot-odroidxu-kvm"
PREFERRED_PROVIDER_u-boot = "u-boot-odroidxu-kvm" 

KERNEL_IMAGETYPE = "uImage"

UBOOT_ARCH = "arm"
UBOOT_ENTRYPOINT = "0x40008000"
UBOOT_LOADADDRESS = "0x40008000"

EXTRA_IMAGEDEPENDS += "virtual/bootloader"

GUI_MACHINE_CLASS = "smallscreen"
```

## conf/machine/odroidxu-kvm.conf
```bitbake
#@TYPE: Machine
#@NAME: ODROID-XU KVM
#@DESCRIPTION: Machine configuration for the ODROID XU board used as KVM Hypervisor

DEFAULTTUNE ?= "cortexa15thf-neon"

require conf/machine/include/odroid-a15.inc

PREFERRED_PROVIDER_virtual/kernel = "linux-hardkernel-odroidxu"
PREFERRED_PROVIDER_virtual/bootloader = "u-boot-odroidxu-kvm"
PREFERRED_PROVIDER_u-boot = "u-boot-odroidxu-kvm"

IMAGE_FSTYPES = "tar.gz"

SERIAL_CONSOLE = "115200 ttySAC2"

UBOOT_MACHINE = "smdk5410_config"

KERNEL_DEVICETREE_odroidxu-kvm = "exynos5410-odroidxu.dtb"
```

## conf/machine/odroidxu3-kvm.conf
```bitbake
#@TYPE: Machine
#@NAME: ODROID-XU3 KVM
#@DESCRIPTION: Machine configuration for the ODROID XU3 board used as KVM Hypervisor

require conf/machine/include/odroid-a15.inc

PREFERRED_PROVIDER_virtual/kernel = "linux-hardkernel-odroidxu3"
PREFERRED_PROVIDER_virtual/bootloader = "u-boot-odroidxu3-kvm"
PREFERRED_PROVIDER_u-boot = "u-boot-odroidxu3-kvm"

IMAGE_FSTYPES = "tar.gz"

SERIAL_CONSOLE = "115200 ttySAC2"

UBOOT_MACHINE = "odroid_config"

KERNEL_DEVICETREE_odroidxu3-kvm = "exynos5422-odroidxu3.dtb"
```
